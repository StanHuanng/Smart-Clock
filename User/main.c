/**
*****************************************************************************************************
  * @copyright	(c)  Shenzhen Saiyuan Microelectronics Co., Ltd
  * @file	         main.c
  * @author	 
  * @version 	
  * @date	
  * @brief	         
  * @details         Contains the MCU initialization function and its H file
 *****************************************************************************************************
 * @attention
 *
 *****************************************************************************************************
 */
/*******************Includes************************************************************************/

#include "SC_Init.h"
#include "SC_it.h"
#include "OLED.h"
#include "..\Drivers\SCDriver_list.h"
#include "HeadFiles\SysFunVarDefine.h"
#include "CLOCK.h"
#include "RGB.h"
#include "Buzzer.h"
#include "Motor.h"
#include "IR.h"
#include "menu.h"
#include "Key.h"

/**************************************Generated by EasyCodeCube*************************************/
//Forbid editing areas between the labels !!!

/*************************************.Generated by EasyCodeCube.************************************/
/**
  * @brief This function implements main function.
  * @note 
  * @param
  */

int a=0;
int KeyNum=0;
extern int RGB_Flag,RGB_mode,sec,min,hour;
extern int menu_state;
extern int menu_state0;
extern int menu_state1;
extern int menu_state2;

int main(void)
{
    /*<Generated by EasyCodeCube begin>*/
    /*<UserCodeStart>*//*<SinOne-Tag><36>*/    
    extern int RGB_Flag,RGB_mode,sec,min,hour;
    extern int menu_state;
    extern int menu_state0;
    extern int menu_state1;
    extern int menu_state2;IcResourceInit();
    OLED_Init();
    /*<UserCodeEnd>*//*<SinOne-Tag><36>*/
    /*<UserCodeStart>*//*<SinOne-Tag><4>*/
    /*****MainLoop*****/
    while(1)
    {
        /*<UserCodeStart>*//*<SinOne-Tag><14>*/
        /***User program***/
        //motor_vibrate();
        //RGB_choosemode();
        //OLED_Showtime();
        //alarm_clock_start();
        //snooze();
        //Buzzer_ON();
        choose_music();
        OLED_clock();
        
        if (menu_state0==0)
        {
            OLED_clock();
            OLED_Showtime();
            
        }
        if(menu_state==0)
        {
            menu_state= menu_main();
            OLED_clock();
        }
        if(menu_state==1)
        {
            menu_state1=menu_clock();
            OLED_clock();
        } 
        if( menu_state1==1)
        {
            menu_SetTime();
            OLED_clock();
            
        }
        if( menu_state1==2)
        {
            menu_Snooze();
            
        }
        if( menu_state1==3)
        {
            
            
        }
        
        if(menu_state==2)
        {
            menu_music();
        }  
        
        if(menu_state==3)
        {
            menu_state2=menu_setting();
        }  
        if(menu_state2==1)
        {
            RGB_mode=menu_rgb()-1;
            RGB_choosemode();
        }
        if(menu_state2==2)
        {
            motor_vibrate();
        }
        // OLED_clock();
        
        /*<UserCodeEnd>*//*<SinOne-Tag><14>*/
        
        /*<Begin-Inserted by EasyCodeCube for Condition>*/
    }
    /*<UserCodeEnd>*//*<SinOne-Tag><4>*/
    /*<Generated by EasyCodeCube end>*/
}
